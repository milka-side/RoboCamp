#include "Car_Peripherals.h"
#include "Freenove_VK16K33_Lib_For_ESP32.h"
#include "driver/rmt.h"

// --- Об'єкти для роботи з обладнанням ---
Freenove_ESP32_VK16K33 matrix = Freenove_ESP32_VK16K33();

// =========================================================
// WS2812 ДРАЙВЕР НАПРЯМУ ЧЕРЕЗ RMT (без сторонніх бібліотек)
// =========================================================
#define WS2812_GPIO         32
#define WS2812_COUNT        12
#define WS2812_RMT_CHANNEL  RMT_CHANNEL_0

// Таймінги WS2812 у "тіках" RMT. clk_div=2 при 80МГц APB -> 1 тік = 25нс.
#define WS2812_T0H  16   // 0.40 мкс
#define WS2812_T0L  34   // 0.85 мкс
#define WS2812_T1H  34   // 0.85 мкс
#define WS2812_T1L  16   // 0.40 мкс
#define WS2812_RESET_US 60

static uint8_t led_r[WS2812_COUNT];
static uint8_t led_g[WS2812_COUNT];
static uint8_t led_b[WS2812_COUNT];

void WS2812_Init() {
  rmt_config_t config = RMT_DEFAULT_CONFIG_TX((gpio_num_t)WS2812_GPIO, WS2812_RMT_CHANNEL);
  config.clk_div = 2; // 1 тік = 25нс
  rmt_config(&config);
  rmt_driver_install(config.channel, 0, 0);
}

// Записує буфер led_r/g/b на стрічку
static void WS2812_Flush() {
  static rmt_item32_t items[WS2812_COUNT * 24 + 1];
  int idx = 0;

  for (int i = 0; i < WS2812_COUNT; i++) {
    // Порядок передачі WS2812 — GRB
    uint8_t colors[3] = { led_g[i], led_r[i], led_b[i] };
    for (int c = 0; c < 3; c++) {
      for (int bit = 7; bit >= 0; bit--) {
        bool one = (colors[c] >> bit) & 0x01;
        items[idx].level0    = 1;
        items[idx].duration0 = one ? WS2812_T1H : WS2812_T0H;
        items[idx].level1    = 0;
        items[idx].duration1 = one ? WS2812_T1L : WS2812_T0L;
        idx++;
      }
    }
  }

  // Reset-імпульс в кінці (низький рівень, довша пауза)
  items[idx].level0 = 0;
  items[idx].duration0 = WS2812_RESET_US * 40; // *40, бо 1 тік = 25нс -> 40 тіків/мкс
  items[idx].level1 = 0;
  items[idx].duration1 = 0;
  idx++;

  rmt_write_items(WS2812_RMT_CHANNEL, items, idx, true /* wait for finish */);
}

// =========================================================
// Піни для підключення екрану
// =========================================================
#define EMOTION_ADDRESS 0x71
#define EMOTION_SDA     13
#define EMOTION_SCL     14

// =========================================================
// ЗОБРАЖЕННЯ ТА ЕМОЦІЇ ДЛЯ МАТРИЦІ (Масиви байтів)
// =========================================================
byte img_clear[8] =       { 0x00, 0x00, 0x00, 0x00, 0x00, 0x00, 0x00, 0x00 };
byte img_arrow_right[8] =  { 0x18, 0x0C, 0x06, 0xFF, 0xFF, 0x06, 0x0C, 0x18 };
byte img_arrow_left[8] = { 0x18, 0x30, 0x60, 0xFF, 0xFF, 0x60, 0x30, 0x18 };

byte eyeRotate1[][8]  = {
  {0x00, 0x3C, 0x4E, 0x4E, 0x7E, 0x7E, 0x3C, 0x00}, {0x00, 0x3C, 0x66, 0x66, 0x7E, 0x7E, 0x3C, 0x00},
  {0x00, 0x3C, 0x72, 0x72, 0x7E, 0x7E, 0x3C, 0x00}, {0x00, 0x3C, 0x7E, 0x72, 0x72, 0x7E, 0x3C, 0x00},
  {0x00, 0x3C, 0x7E, 0x7E, 0x72, 0x72, 0x3C, 0x00}, {0x00, 0x3C, 0x7E, 0x7E, 0x66, 0x66, 0x3C, 0x00},
  {0x00, 0x3C, 0x7E, 0x7E, 0x4E, 0x4E, 0x3C, 0x00}, {0x00, 0x3C, 0x7E, 0x4E, 0x4E, 0x7E, 0x3C, 0x00}
};

byte eyeRotate2[][8] = {
  {0x00, 0x3C, 0x72, 0x72, 0x7E, 0x7E, 0x3C, 0x00}, {0x00, 0x3C, 0x66, 0x66, 0x7E, 0x7E, 0x3C, 0x00},
  {0x00, 0x3C, 0x4E, 0x4E, 0x7E, 0x7E, 0x3C, 0x00}, {0x00, 0x3C, 0x7E, 0x4E, 0x4E, 0x7E, 0x3C, 0x00},
  {0x00, 0x3C, 0x7E, 0x7E, 0x4E, 0x4E, 0x3C, 0x00}, {0x00, 0x3C, 0x7E, 0x7E, 0x66, 0x66, 0x3C, 0x00},
  {0x00, 0x3C, 0x7E, 0x7E, 0x72, 0x72, 0x3C, 0x00}, {0x00, 0x3C, 0x7E, 0x72, 0x72, 0x7E, 0x3C, 0x00}
};

byte eyeBlink[][8] = {
  {0x00, 0x00, 0x3C, 0x66, 0x42, 0x66, 0x3C, 0x00}, {0x00, 0x00, 0x3C, 0x7E, 0x42, 0x66, 0x3C, 0x00},
  {0x00, 0x00, 0x3C, 0x7E, 0x7E, 0x7E, 0x3C, 0x00}, {0x00, 0x00, 0x3C, 0x7E, 0x42, 0x66, 0x3C, 0x00},
  {0x00, 0x00, 0x3C, 0x7E, 0x7E, 0x7E, 0x3C, 0x00}
};

byte eyeSmile[][8] = {
  {0x00, 0x00, 0x18, 0x24, 0x42, 0x00, 0x00, 0x00}, {0x00, 0x18, 0x24, 0x42, 0x00, 0x00, 0x00, 0x00}
};

byte eyeCry1[][8] = {
  {0x00, 0x00, 0x7E, 0x3C, 0x00, 0x00, 0x00, 0x00}, {0x00, 0x00, 0x7E, 0x3C, 0x18, 0x00, 0x00, 0x00},
  {0x00, 0x00, 0x7E, 0x3C, 0x00, 0x18, 0x00, 0x00}, {0x00, 0x00, 0x7E, 0x3C, 0x00, 0x00, 0x18, 0x00},
  {0x00, 0x00, 0x7E, 0x3C, 0x00, 0x00, 0x00, 0x18}, {0x00, 0x00, 0x7E, 0x3C, 0x00, 0x00, 0x00, 0x00},
  {0x00, 0x00, 0x7E, 0x3C, 0x00, 0x00, 0x00, 0x00}, {0x00, 0x00, 0x7E, 0x3C, 0x00, 0x00, 0x00, 0x00},
  {0x00, 0x00, 0x7E, 0x3C, 0x00, 0x00, 0x00, 0x00}, {0x00, 0x00, 0x7E, 0x3C, 0x00, 0x00, 0x00, 0x00}
};

byte eyeCry2[][8] = {
  {0x00, 0x00, 0x7E, 0x3C, 0x00, 0x00, 0x00, 0x00}, {0x00, 0x00, 0x7E, 0x3C, 0x00, 0x00, 0x00, 0x00},
  {0x00, 0x00, 0x7E, 0x3C, 0x00, 0x00, 0x00, 0x00}, {0x00, 0x00, 0x7E, 0x3C, 0x00, 0x00, 0x00, 0x00},
  {0x00, 0x00, 0x7E, 0x3C, 0x00, 0x00, 0x00, 0x00}, {0x00, 0x00, 0x7E, 0x3C, 0x18, 0x00, 0x00, 0x00},
  {0x00, 0x00, 0x7E, 0x3C, 0x00, 0x18, 0x00, 0x00}, {0x00, 0x00, 0x7E, 0x3C, 0x00, 0x00, 0x18, 0x00},
  {0x00, 0x00, 0x7E, 0x3C, 0x00, 0x00, 0x00, 0x18}, {0x00, 0x00, 0x7E, 0x3C, 0x00, 0x00, 0x00, 0x00}
};

byte wheel_left[][8] = {
  {0x18, 0x10, 0x10, 0x9F, 0xF9, 0x08, 0x08, 0x18}, {0x20, 0x42, 0x25, 0x18, 0x18, 0xA4, 0x42, 0x04}, {0x0C, 0x08, 0x88, 0xF8, 0x1F, 0x11, 0x10, 0x30}
};

byte wheel_right[][8] = {
  {0x18, 0x08, 0x08, 0xF9, 0x9F, 0x10, 0x10, 0x18}, {0x04, 0x42, 0xA4, 0x18, 0x18, 0x25, 0x42, 0x20}, {0x30, 0x10, 0x11, 0x1F, 0xF8, 0x88, 0x08, 0x0C}
};

byte static_emotion_left[][8] = {
  {0x44, 0x28, 0x10, 0x28, 0x44, 0x00, 0x00, 0x07}, {0x00, 0x00, 0x00, 0x38, 0x00, 0x00, 0x00, 0x07},
  {0x38, 0x44, 0x54, 0x54, 0x44, 0x38, 0x00, 0x03}, {0x00, 0x04, 0x04, 0x08, 0x30, 0x00, 0x03, 0x04},
  {0x00, 0x10, 0x28, 0x28, 0x00, 0x00, 0x07, 0x04}, {0x00, 0x28, 0x10, 0x28, 0x00, 0x00, 0x00, 0x07},
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  {0x38, 0x44, 0x42, 0x12, 0x04, 0x18, 0x03, 0x02}
};

byte static_emotion_right[][8] = {
  {0x22, 0x14, 0x08, 0x14, 0x22, 0x00, 0x00, 0xE0}, {0x00, 0x1C, 0x1C, 0x1C, 0x00, 0x00, 0x20, 0xE0},
  {0x1C, 0x22, 0x2A, 0x2A, 0x22, 0x1C, 0x00, 0xC0}, {0x00, 0x20, 0x20, 0x10, 0x0C, 0x00, 0xC0, 0x20},
  {0x00, 0x08, 0x14, 0x14, 0x00, 0x00, 0xE0, 0x20}, {0x00, 0x1C, 0x14, 0x1C, 0x00, 0x20, 0x20, 0xC0},
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  {0x1C, 0x22, 0x42, 0x48, 0x20, 0x18, 0xC0, 0x40}
};

// =========================================================
// СИСТЕМА АНІМАЦІЙ
// =========================================================
enum AnimMode {
  ANIM_NONE, ANIM_ROTATE, ANIM_BLINK, ANIM_SMILE, ANIM_CRY, ANIM_WHEEL_LEFT, ANIM_WHEEL_RIGHT
};

AnimMode current_anim = ANIM_NONE;
int current_frame = 0;
unsigned long last_frame_time = 0;

void setAnimation(AnimMode mode) {
  if (current_anim != mode) {
    current_anim = mode;
    current_frame = 0;
    last_frame_time = millis(); 
  }
}

// =========================================================
// ОСНОВНЕ НАЛАШТУВАННЯ
// =========================================================
void Car_Peripherals_Setup() {
  // Екран
  matrix.init(EMOTION_ADDRESS, EMOTION_SDA, EMOTION_SCL);
  matrix.setBrightness(15);
  Matrix_Clear();

  // Світлодіоди (WS2812 напряму через RMT)
  WS2812_Init();
  LED_TurnOffAll();
}

// =========================================================
// ФУНКЦІЇ СВІТЛОДІОДІВ
// =========================================================
void LED_SetColor(int led_number, int r, int g, int b) {
  if (led_number < 0 || led_number >= WS2812_COUNT) return;
  led_r[led_number] = (uint8_t)r;
  led_g[led_number] = (uint8_t)g;
  led_b[led_number] = (uint8_t)b;
  WS2812_Flush();
}

void LED_SetAllColors(int r, int g, int b) {
  for (int i = 0; i < WS2812_COUNT; i++) {
    led_r[i] = (uint8_t)r;
    led_g[i] = (uint8_t)g;
    led_b[i] = (uint8_t)b;
  }
  WS2812_Flush();
}

void LED_TurnOff(int led_number) {
  LED_SetColor(led_number, 0, 0, 0);
}

void LED_TurnOffAll() {
  LED_SetAllColors(0, 0, 0);
}

// =========================================================
// ФУНКЦІЇ ЕКРАНУ (МАТРИЦІ) - СТАТИЧНІ
// =========================================================
void Matrix_Clear() {
  setAnimation(ANIM_NONE);
  matrix.showStaticArray(img_clear, img_clear);
}

void Matrix_ShowArrowLeft() {
  setAnimation(ANIM_NONE);
  matrix.showStaticArray(img_arrow_left, img_arrow_left);
}

void Matrix_ShowArrowRight() {
  setAnimation(ANIM_NONE);
  matrix.showStaticArray(img_arrow_right, img_arrow_right);
}

void Matrix_ShowStaticEmotion(int id) {
  setAnimation(ANIM_NONE);
  int count = sizeof(static_emotion_left) / sizeof(static_emotion_left[0]);
  id = constrain(id, 0, count - 1);
  matrix.showStaticArray(static_emotion_left[id], static_emotion_right[id]);
}

// =========================================================
// ФУНКЦІЇ ЕКРАНУ (МАТРИЦІ) - АНІМАЦІЇ
// =========================================================
void Matrix_AnimRotate()     { setAnimation(ANIM_ROTATE); }
void Matrix_AnimBlink()      { setAnimation(ANIM_BLINK); }
void Matrix_AnimSmile()      { setAnimation(ANIM_SMILE); }
void Matrix_AnimCry()        { setAnimation(ANIM_CRY); }
void Matrix_AnimWheelLeft()  { setAnimation(ANIM_WHEEL_LEFT); }
void Matrix_AnimWheelRight() { setAnimation(ANIM_WHEEL_RIGHT); }

// =========================================================
// ФУНКЦІЇ ЕКРАНУ - АВТОМАТИЧНЕ ОНОВЛЕННЯ 
// =========================================================
void Matrix_Update() {
  if (current_anim == ANIM_NONE) return; 

  unsigned long current_time = millis();
  
  switch (current_anim) {
    case ANIM_ROTATE:
      if (current_time - last_frame_time >= 150) {
        last_frame_time = current_time;
        matrix.showStaticArray(eyeRotate1[current_frame], eyeRotate2[current_frame]);
        current_frame = (current_frame + 1) % (sizeof(eyeRotate1) / 8);
      }
      break;

    case ANIM_BLINK:
      if (current_time - last_frame_time >= 100) {
        last_frame_time = current_time;
        if (current_frame < 10) {
          matrix.showStaticArray(eyeBlink[0], eyeBlink[0]);
        } else {
          int idx = current_frame - 10;
          matrix.showStaticArray(eyeBlink[idx], eyeBlink[idx]);
        }
        current_frame++;
        if (current_frame >= 10 + (sizeof(eyeBlink) / 8)) current_frame = 0;
      }
      break;

    case ANIM_SMILE:
      if (current_time - last_frame_time >= 200) {
        last_frame_time = current_time;
        matrix.showStaticArray(eyeSmile[current_frame], eyeSmile[current_frame]);
        current_frame = (current_frame + 1) % (sizeof(eyeSmile) / 8);
      }
      break;

    case ANIM_CRY:
      if (current_time - last_frame_time >= 200) {
        last_frame_time = current_time;
        matrix.showStaticArray(eyeCry1[current_frame], eyeCry2[current_frame]);
        current_frame = (current_frame + 1) % (sizeof(eyeCry1) / 8);
      }
      break;

    case ANIM_WHEEL_LEFT:
      if (current_time - last_frame_time >= 100) {
        last_frame_time = current_time;
        matrix.showStaticArray(wheel_left[current_frame], wheel_left[current_frame]);
        current_frame = (current_frame + 1) % (sizeof(wheel_left) / 8);
      }
      break;

    case ANIM_WHEEL_RIGHT:
      if (current_time - last_frame_time >= 100) {
        last_frame_time = current_time;
        matrix.showStaticArray(wheel_right[current_frame], wheel_right[current_frame]);
        current_frame = (current_frame + 1) % (sizeof(wheel_right) / 8);
      }
      break;
      
    default:
      break;
  }
}